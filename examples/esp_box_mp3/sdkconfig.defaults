## examples/esp_box_mp3/sdkconfig.defaults
```kconfig
CONFIG_IDF_TARGET="esp32s3"
CONFIG_ESPTOOLPY_FLASHMODE_QIO=y
CONFIG_ESPTOOLPY_FLASHSIZE_16MB=y
CONFIG_ESP_CONSOLE_USB_SERIAL_JTAG=y

CONFIG_AUDIO_PLAYER_ENABLE_MP3=y
# CONFIG_AUDIO_PLAYER_ENABLE_WAV is not set
# CONFIG_AUDIO_PLAYER_ENABLE_HTTP_STREAM is not set
```

## examples/esp_box_mp3_no_bsp/sdkconfig.defaults
```kconfig
CONFIG_IDF_TARGET="esp32s3"
CONFIG_ESPTOOLPY_FLASHMODE_QIO=y
CONFIG_ESPTOOLPY_FLASHSIZE_16MB=y
CONFIG_ESP_CONSOLE_USB_SERIAL_JTAG=y

CONFIG_AUDIO_PLAYER_ENABLE_MP3=y
CONFIG_AUDIO_PLAYER_ENABLE_WAV=y
CONFIG_AUDIO_PLAYER_ENABLE_HTTP_STREAM=y

CONFIG_CODEC_ES8311_SUPPORT=y
# CONFIG_CODEC_I2C_BACKWARD_COMPATIBLE is not set
```
